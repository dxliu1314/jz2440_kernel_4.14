## arch/arm/configs/jz2440_defconfig
```kconfig
# system
CONFIG_SYSVIPC=y
CONFIG_LOG_BUF_SHIFT=14
CONFIG_ZBOOT_ROM_TEXT=0x0
CONFIG_ZBOOT_ROM_BSS=0x0
CONFIG_AEABI=y
CONFIG_TMPFS=y
CONFIG_SYSFS=y

# the soc
CONFIG_MACH_JZ2440=y
CONFIG_S3C24XX_SMDK=y
CONFIG_PLAT_SAMSUNG=y
CONFIG_PLAT_S3C24XX=y
CONFIG_ARCH_S3C24XX=y
CONFIG_ARCH_S3C2440=y
CONFIG_CPU_S3C2440=y

# the uart
CONFIG_SERIAL_SAMSUNG=y
CONFIG_SERIAL_SAMSUNG_CONSOLE=y
CONFIG_SERIAL_SAMSUNG_DEBUG=y

# the mtd
CONFIG_MTD=y
CONFIG_MTD_REDBOOT_PARTS=y
CONFIG_MTD_REDBOOT_PARTS_UNALLOCATED=y
CONFIG_MTD_CMDLINE_PARTS=y
CONFIG_MTD_BLOCK=y
CONFIG_MTD_CFI=y
CONFIG_MTD_JEDECPROBE=y
CONFIG_MTD_CFI_INTELEXT=y
CONFIG_MTD_CFI_AMDSTD=y
CONFIG_MTD_ROM=y
CONFIG_MTD_NAND=y
CONFIG_MTD_NAND_S3C2410=y

# file system
CONFIG_MISC_FILESYSTEMS=y
CONFIG_YAFFS_FS=y

# led
CONFIG_NEW_LEDS=y
CONFIG_LEDS_CLASS=y
CONFIG_LEDS_S3C24XX=y
```
